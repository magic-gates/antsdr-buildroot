## Config.in
```kconfig
menu "External packages"
    source "$BR2_EXTERNAL_MAGIC_SDR_PATH/package/magic-driver/Config.in"
endmenu
```

## board/antsdr_e310/buildroot/antsdr_e310_defconfig
```kconfig
BR2_arm=y
BR2_cortex_a9=y
BR2_ARM_ENABLE_NEON=y
BR2_ARM_ENABLE_VFP=y
BR2_ARM_FPU_NEON=y
BR2_KERNEL_HEADERS_6_18=y
BR2_BINUTILS_VERSION_2_46_X=y
BR2_GCC_VERSION_15_X=y
BR2_OPTIMIZE_3=y
BR2_TARGET_GENERIC_HOSTNAME="dev"
BR2_TARGET_GENERIC_ISSUE="Magic Gates"
BR2_TARGET_GENERIC_ROOT_PASSWD="magic"
BR2_ROOTFS_OVERLAY="$(BR2_EXTERNAL_MAGIC_SDR_PATH)/rootfs"
BR2_ROOTFS_POST_IMAGE_SCRIPT="$(BR2_EXTERNAL_MAGIC_SDR_PATH)/board/antsdr_e310/post-image.sh"
BR2_LINUX_KERNEL=y
BR2_LINUX_KERNEL_CUSTOM_TARBALL=y
BR2_LINUX_KERNEL_CUSTOM_TARBALL_LOCATION="https://github.com/analogdevicesinc/linux/archive/refs/tags/2023_r2_p1.tar.gz"
BR2_LINUX_KERNEL_USE_CUSTOM_CONFIG=y
BR2_LINUX_KERNEL_CUSTOM_CONFIG_FILE="$(BR2_EXTERNAL_MAGIC_SDR_PATH)/board/antsdr_e310/kernel/antsdr_e310_defconfig"
BR2_LINUX_KERNEL_DTS_SUPPORT=y
BR2_LINUX_KERNEL_CUSTOM_DTS_DIR="$(BR2_EXTERNAL_MAGIC_SDR_PATH)/board/antsdr_e310/dts/"
BR2_PACKAGE_LINUX_TOOLS_IIO=y
BR2_PACKAGE_BINUTILS=y
BR2_PACKAGE_BINUTILS_TARGET=y
BR2_PACKAGE_LINUX_FIRMWARE=y
BR2_PACKAGE_LIBIIO=y
BR2_PACKAGE_DROPBEAR=y
BR2_PACKAGE_RSYNC=y
BR2_PACKAGE_FILE=y
BR2_TARGET_ROOTFS_CPIO=y
BR2_TARGET_ROOTFS_CPIO_GZIP=y
# BR2_TARGET_ROOTFS_TAR is not set
BR2_TARGET_UBOOT=y
BR2_TARGET_UBOOT_BUILD_SYSTEM_KCONFIG=y
BR2_TARGET_UBOOT_CUSTOM_TARBALL=y
BR2_TARGET_UBOOT_CUSTOM_TARBALL_LOCATION="https://github.com/Xilinx/u-boot-xlnx/archive/refs/tags/xilinx-v2025.2.tar.gz"
BR2_TARGET_UBOOT_BOARD_DEFCONFIG="xilinx_zynq_virt"
BR2_TARGET_UBOOT_CONFIG_FRAGMENT_FILES="$(BR2_EXTERNAL_MAGIC_SDR_PATH)/board/antsdr_e310/u-boot.fragment"
BR2_TARGET_UBOOT_CUSTOM_DTS_PATH="$(BR2_EXTERNAL_MAGIC_SDR_PATH)/board/antsdr_e310/dts/device.dts"
BR2_PACKAGE_HOST_UBOOT_TOOLS=y
BR2_PACKAGE_HOST_UBOOT_TOOLS_FIT_SUPPORT=y
BR2_PACKAGE_HOST_UBOOT_TOOLS_BOOT_SCRIPT=y
BR2_PACKAGE_HOST_UBOOT_TOOLS_BOOT_SCRIPT_SOURCE="$(BR2_EXTERNAL_MAGIC_SDR_PATH)/board/antsdr_e310/boot.cmd"
BR2_PACKAGE_MAGIC_DRIVER=y
```

## board/antsdr_e310/device.its
```
/dts-v1/;

/ {
    description = "Image";
    #address-cells = <1>;

    images {
        fdt {
            description = "Device Tree";
            data = /incbin/("${DTB}");
            type = "flat_dt";
            arch = "arm";
        };

        kernel {
            description = "Linux kernel";
            data = /incbin/("${KERNEL}");
            type = "kernel";
            arch = "arm";
            os = "linux";
            compression = "none";
            load = <0x3000000>;
            entry = <0x3000000>;

            hash {
                algo = "sha256";
            };
        };

        ramdisk {
            description = "Ramdisk";
            data = /incbin/("${RAMDISK}");
            type = "ramdisk";
            arch = "arm";
            os = "linux";
            compression = "none";

            load = <0x04000000>;
            entry = <0x04000000>;

            hash {
                algo = "sha256";
            };
        };
    };

    configurations {
        default = "config";

        config {
            fdt = "fdt";
            kernel = "kernel";
            ramdisk = "ramdisk";
        };
    };
};
```

## package/magic-driver/Config.in
```kconfig
config BR2_PACKAGE_MAGIC_DRIVER
	bool "magic-driver"
	depends on BR2_LINUX_KERNEL
	help
	  Linux kernel module for magic tricks.
```
